## main/Kconfig.projbuild
```kconfig
menu "WoL Device Config"

config WIFI_SSID
    string "Wifi SSID"
    default ""

config WIFI_PASS
    string "Wifi Password"
    default ""

config MAC_ADDR
    string "PC MAC Address"
    default ""

config BROKER_URI
    string "Broker URL"
    default ""

config MQTT_USER
    string "MQTT Credentials Username"
    default ""

config MQTT_PASS
    string "MQTT Credentials Password"
    default ""

endmenu
```
